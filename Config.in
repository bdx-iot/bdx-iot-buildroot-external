## Config.in
```kconfig
source "$BR2_EXTERNAL_BDXIOT_EXTERNAL_PATH/package/dlt-daemon/Config.in"
source "$BR2_EXTERNAL_BDXIOT_EXTERNAL_PATH/package/optee-i2c-test/Config.in"
```

## configs/imx8mp_debix_model_a_defconfig
```kconfig
BR2_aarch64=y
BR2_ARM_FPU_VFPV3=y
BR2_PACKAGE_HOST_LINUX_HEADERS_CUSTOM_6_12=y
BR2_TOOLCHAIN_BUILDROOT_CXX=y
BR2_CCACHE=y
BR2_TARGET_GENERIC_HOSTNAME="debix-model-a"
BR2_INIT_SYSTEMD=y
BR2_TARGET_GENERIC_GETTY_PORT="ttymxc1"
BR2_ROOTFS_OVERLAY="$(BR2_EXTERNAL_BDXIOT_EXTERNAL_PATH)/board/common/rootfs_overlay $(BR2_EXTERNAL_BDXIOT_EXTERNAL_PATH)/board/debix-model-a/rootfs_overlay"
BR2_GLOBAL_PATCH_DIR="$(BR2_EXTERNAL_BDXIOT_EXTERNAL_PATH)/board/common/patches"
BR2_PACKAGE_OVERRIDE_FILE="$(BR2_EXTERNAL_BDXIOT_EXTERNAL_PATH)/board/common/swupdate/local.mk"
BR2_ROOTFS_POST_BUILD_SCRIPT="$(BR2_EXTERNAL_BDXIOT_EXTERNAL_PATH)/board/debix-model-a/post-build.sh"
BR2_ROOTFS_POST_IMAGE_SCRIPT="$(BR2_EXTERNAL_BDXIOT_EXTERNAL_PATH)/board/debix-model-a/fix-tee-bin.sh board/freescale/common/imx/imx8-bootloader-prepare.sh $(BR2_EXTERNAL_BDXIOT_EXTERNAL_PATH)/board/debix-model-a/post-image.sh"
BR2_ROOTFS_POST_SCRIPT_ARGS="${UBOOT_DIR}/arch/arm/dts/imx8mp-debix-model-a.dtb"
BR2_LINUX_KERNEL=y
BR2_LINUX_KERNEL_CUSTOM_TARBALL=y
BR2_LINUX_KERNEL_CUSTOM_TARBALL_LOCATION="$(call github,nxp-imx,linux-imx,lf-6.12.3-1.0.0)/linux-imx-lf-6.12.3-1.0.0.tar.gz"
BR2_LINUX_KERNEL_DEFCONFIG="imx_v8"
BR2_LINUX_KERNEL_CONFIG_FRAGMENT_FILES="$(BR2_EXTERNAL_BDXIOT_EXTERNAL_PATH)/board/common/linux/wifi.fragment $(BR2_EXTERNAL_BDXIOT_EXTERNAL_PATH)/board/debix-model-a/linux/rpmsg.fragment $(BR2_EXTERNAL_BDXIOT_EXTERNAL_PATH)/board/common/linux/bluetooth.fragment"
BR2_LINUX_KERNEL_DTS_SUPPORT=y
BR2_LINUX_KERNEL_INTREE_DTS_NAME="freescale/imx8mp-debix-model-a"
BR2_LINUX_KERNEL_CUSTOM_DTS_DIR="$(BR2_EXTERNAL_BDXIOT_EXTERNAL_PATH)/board/debix-model-a/linux/dts"
BR2_LINUX_KERNEL_NEEDS_HOST_OPENSSL=y
BR2_PACKAGE_LINUX_TOOLS_GPIO=y
BR2_PACKAGE_LINUX_TOOLS_IIO=y
BR2_PACKAGE_BUSYBOX_CONFIG_FRAGMENT_FILES="$(BR2_EXTERNAL_BDXIOT_EXTERNAL_PATH)/board/common/busybox.fragment"
BR2_PACKAGE_ZSTD=y
BR2_PACKAGE_E2FSPROGS=y
BR2_PACKAGE_LINUX_FIRMWARE=y
BR2_PACKAGE_LINUX_FIRMWARE_BRCM_BCM43XXX=y
BR2_PACKAGE_DBUS_BROKER=y
BR2_PACKAGE_FREESCALE_IMX=y
BR2_PACKAGE_FREESCALE_IMX_PLATFORM_IMX8MP=y
BR2_PACKAGE_FIRMWARE_IMX=y
BR2_PACKAGE_I2C_TOOLS=y
BR2_PACKAGE_PARTED=y
BR2_PACKAGE_LUA=y
BR2_PACKAGE_LIBARCHIVE=y
BR2_PACKAGE_LIBSSH=y
BR2_PACKAGE_LIBSSH_SERVER=y
BR2_PACKAGE_LIBSSH2=y
BR2_PACKAGE_LIBOPENSSL_BIN=y
BR2_PACKAGE_SQLITECPP=y
BR2_PACKAGE_LIBCONFIG=y
BR2_PACKAGE_C_PERIPHERY=y
BR2_PACKAGE_LIBGPIOD=y
BR2_PACKAGE_LIBGPIOD_TOOLS=y
BR2_PACKAGE_LIBIIO=y
BR2_PACKAGE_LIBINPUT=y
BR2_PACKAGE_JSON_FOR_MODERN_CPP=y
BR2_PACKAGE_CPPZMQ=y
BR2_PACKAGE_CURLPP=y
BR2_PACKAGE_CZMQ=y
BR2_PACKAGE_LIBRSYNC=y
BR2_PACKAGE_LIBURIPARSER=y
BR2_PACKAGE_LIBWEBSOCKETS=y
BR2_PACKAGE_LIBEVENT=y
BR2_PACKAGE_CAN_UTILS=y
BR2_PACKAGE_IPROUTE2=y
BR2_PACKAGE_OPENSSH=y
BR2_PACKAGE_WIRELESS_TOOLS=y
BR2_PACKAGE_WPA_SUPPLICANT=y
BR2_PACKAGE_WPA_SUPPLICANT_AUTOSCAN=y
BR2_PACKAGE_WPA_SUPPLICANT_CLI=y
BR2_PACKAGE_WPA_SUPPLICANT_PASSPHRASE=y
BR2_PACKAGE_WPA_SUPPLICANT_DBUS=y
BR2_PACKAGE_WPA_SUPPLICANT_DBUS_INTROSPECTION=y
BR2_PACKAGE_OPTEE_EXAMPLES=y
BR2_PACKAGE_DLT_DAEMON=y
BR2_PACKAGE_DLT_DAEMON_SYSTEMD_JOURNAL=y
BR2_PACKAGE_DLT_DAEMON_SYSTEM=y
BR2_PACKAGE_DLT_DAEMON_CONSOLE=y
BR2_PACKAGE_SWUPDATE=y
BR2_PACKAGE_SWUPDATE_CONFIG="$(BR2_EXTERNAL_BDXIOT_EXTERNAL_PATH)/board/common/swupdate/defconfig"
BR2_PACKAGE_NANO=y
BR2_PACKAGE_VIM=y
BR2_TARGET_ROOTFS_EXT2=y
BR2_TARGET_ROOTFS_EXT2_4=y
BR2_TARGET_ROOTFS_EXT2_SIZE="384M"
BR2_TARGET_ROOTFS_EXT2_ZSTD=y
BR2_TARGET_ARM_TRUSTED_FIRMWARE=y
BR2_TARGET_ARM_TRUSTED_FIRMWARE_CUSTOM_TARBALL=y
BR2_TARGET_ARM_TRUSTED_FIRMWARE_CUSTOM_TARBALL_LOCATION="$(call github,nxp-imx,imx-atf,lf-6.12.3-1.0.0)/imx-atf-lf-6.12.3-1.0.0.tar.gz"
BR2_TARGET_ARM_TRUSTED_FIRMWARE_PLATFORM="imx8mp"
BR2_TARGET_ARM_TRUSTED_FIRMWARE_BL31=y
BR2_TARGET_ARM_TRUSTED_FIRMWARE_ADDITIONAL_VARIABLES="SPD=opteed LOG_LEVEL=30"
BR2_TARGET_OPTEE_OS=y
BR2_TARGET_OPTEE_OS_CUSTOM_TARBALL=y
BR2_TARGET_OPTEE_OS_CUSTOM_TARBALL_LOCATION="$(call github,nxp-imx,imx-optee-os,lf-6.12.3-1.0.0)/imx-optee-os-lf-6.12.3-1.0.0.tar.gz"
BR2_TARGET_OPTEE_OS_NEEDS_PYTHON_CRYPTOGRAPHY=y
BR2_TARGET_OPTEE_OS_PLATFORM="imx-mx8mpevk"
BR2_TARGET_OPTEE_OS_ADDITIONAL_VARIABLES="CFG_TEE_CORE_LOG_LEVEL=4 CFG_DDR_SIZE=0x80000000"
BR2_TARGET_UBOOT=y
BR2_TARGET_UBOOT_BUILD_SYSTEM_KCONFIG=y
BR2_TARGET_UBOOT_CUSTOM_TARBALL=y
BR2_TARGET_UBOOT_CUSTOM_TARBALL_LOCATION="$(call github,nxp-imx,uboot-imx,lf-6.12.3-1.0.0)/uboot-imx-lf-6.12.3-1.0.0.tar.gz"
BR2_TARGET_UBOOT_PATCH="$(BR2_EXTERNAL_BDXIOT_EXTERNAL_PATH)/board/debix-model-a/u-boot/patches"
BR2_TARGET_UBOOT_BOARD_DEFCONFIG="imx8mp_debix_model_a"
BR2_TARGET_UBOOT_CONFIG_FRAGMENT_FILES="$(BR2_EXTERNAL_BDXIOT_EXTERNAL_PATH)/board/debix-model-a/u-boot/uboot.fragment"
BR2_TARGET_UBOOT_NEEDS_DTC=y
BR2_TARGET_UBOOT_NEEDS_OPENSSL=y
BR2_TARGET_UBOOT_NEEDS_GNUTLS=y
BR2_TARGET_UBOOT_NEEDS_UTIL_LINUX=y
BR2_TARGET_UBOOT_FORMAT_CUSTOM=y
BR2_TARGET_UBOOT_FORMAT_CUSTOM_NAME="u-boot-nodtb.bin"
BR2_TARGET_UBOOT_SPL=y
BR2_TARGET_UBOOT_INITIAL_ENV=y
BR2_PACKAGE_HOST_DOSFSTOOLS=y
BR2_PACKAGE_HOST_ENVIRONMENT_SETUP=y
BR2_PACKAGE_HOST_GENIMAGE=y
BR2_PACKAGE_HOST_IMX_MKIMAGE=y
BR2_PACKAGE_HOST_MTOOLS=y
BR2_PACKAGE_HOST_SWUGENERATOR=y
BR2_PACKAGE_HOST_UBOOT_TOOLS=y
BR2_PACKAGE_HOST_UBOOT_TOOLS_FIT_SUPPORT=y
BR2_PACKAGE_HOST_UBOOT_TOOLS_BOOT_SCRIPT=y
BR2_PACKAGE_HOST_UBOOT_TOOLS_BOOT_SCRIPT_SOURCE="$(BR2_EXTERNAL_BDXIOT_EXTERNAL_PATH)/board/debix-model-a/u-boot/boot.cmd"
```

## configs/warp7_defconfig
```kconfig
BR2_arm=y
BR2_cortex_a7=y
BR2_ARM_FPU_NEON_VFPV4=y
BR2_PACKAGE_HOST_LINUX_HEADERS_CUSTOM_6_12=y
BR2_TOOLCHAIN_BUILDROOT_CXX=y
BR2_CCACHE=y
BR2_TARGET_GENERIC_HOSTNAME="warp7"
BR2_INIT_SYSTEMD=y
BR2_TARGET_GENERIC_GETTY_PORT="ttymxc0"
BR2_ROOTFS_OVERLAY="$(BR2_EXTERNAL_BDXIOT_EXTERNAL_PATH)/board/common/rootfs_overlay $(BR2_EXTERNAL_BDXIOT_EXTERNAL_PATH)/board/warp7/rootfs_overlay"
BR2_PACKAGE_OVERRIDE_FILE="$(BR2_EXTERNAL_BDXIOT_EXTERNAL_PATH)/board/common/swupdate/local.mk"
BR2_ROOTFS_POST_BUILD_SCRIPT="$(BR2_EXTERNAL_BDXIOT_EXTERNAL_PATH)/board/warp7/post-build.sh"
BR2_ROOTFS_POST_IMAGE_SCRIPT="$(BR2_EXTERNAL_BDXIOT_EXTERNAL_PATH)/board/warp7/post-image.sh"
BR2_ROOTFS_POST_SCRIPT_ARGS="${UBOOT_DIR}"
BR2_LINUX_KERNEL=y
BR2_LINUX_KERNEL_CUSTOM_VERSION=y
BR2_LINUX_KERNEL_CUSTOM_VERSION_VALUE="6.12.24"
BR2_LINUX_KERNEL_DEFCONFIG="imx_v6_v7"
BR2_LINUX_KERNEL_CONFIG_FRAGMENT_FILES="$(BR2_EXTERNAL_BDXIOT_EXTERNAL_PATH)/board/common/linux/wifi.fragment $(BR2_EXTERNAL_BDXIOT_EXTERNAL_PATH)/board/common/linux/bluetooth.fragment $(BR2_EXTERNAL_BDXIOT_EXTERNAL_PATH)/board/warp7/linux/sensors.fragment $(BR2_EXTERNAL_BDXIOT_EXTERNAL_PATH)/board/warp7/linux/optee.fragment"
BR2_LINUX_KERNEL_DTS_SUPPORT=y
BR2_LINUX_KERNEL_CUSTOM_DTS_DIR="$(BR2_EXTERNAL_BDXIOT_EXTERNAL_PATH)/board/warp7/linux/dts"
BR2_LINUX_KERNEL_NEEDS_HOST_OPENSSL=y
BR2_PACKAGE_LINUX_TOOLS_GPIO=y
BR2_PACKAGE_LINUX_TOOLS_IIO=y
BR2_PACKAGE_BUSYBOX_CONFIG_FRAGMENT_FILES="$(BR2_EXTERNAL_BDXIOT_EXTERNAL_PATH)/board/common/busybox.fragment"
BR2_PACKAGE_ZSTD=y
BR2_PACKAGE_E2FSPROGS=y
BR2_PACKAGE_LINUX_FIRMWARE=y
BR2_PACKAGE_LINUX_FIRMWARE_BRCM_BCM43XXX=y
BR2_PACKAGE_DBUS_BROKER=y
BR2_PACKAGE_I2C_TOOLS=y
BR2_PACKAGE_PARTED=y
BR2_PACKAGE_LUA=y
BR2_PACKAGE_LIBARCHIVE=y
BR2_PACKAGE_LIBSSH=y
BR2_PACKAGE_LIBSSH_SERVER=y
BR2_PACKAGE_LIBSSH2=y
BR2_PACKAGE_LIBOPENSSL_BIN=y
BR2_PACKAGE_SQLITECPP=y
BR2_PACKAGE_LIBCONFIG=y
BR2_PACKAGE_C_PERIPHERY=y
BR2_PACKAGE_LIBGPIOD=y
BR2_PACKAGE_LIBGPIOD_TOOLS=y
BR2_PACKAGE_LIBIIO=y
BR2_PACKAGE_LIBINPUT=y
BR2_PACKAGE_JSON_FOR_MODERN_CPP=y
BR2_PACKAGE_CPPZMQ=y
BR2_PACKAGE_CURLPP=y
BR2_PACKAGE_CZMQ=y
BR2_PACKAGE_LIBRSYNC=y
BR2_PACKAGE_LIBURIPARSER=y
BR2_PACKAGE_LIBWEBSOCKETS=y
BR2_PACKAGE_LIBEVENT=y
BR2_PACKAGE_CAN_UTILS=y
BR2_PACKAGE_IPROUTE2=y
BR2_PACKAGE_OPENSSH=y
BR2_PACKAGE_WIRELESS_TOOLS=y
BR2_PACKAGE_WPA_SUPPLICANT=y
BR2_PACKAGE_WPA_SUPPLICANT_AUTOSCAN=y
BR2_PACKAGE_WPA_SUPPLICANT_CLI=y
BR2_PACKAGE_WPA_SUPPLICANT_PASSPHRASE=y
BR2_PACKAGE_WPA_SUPPLICANT_DBUS=y
BR2_PACKAGE_WPA_SUPPLICANT_DBUS_INTROSPECTION=y
BR2_PACKAGE_OPTEE_EXAMPLES=y
BR2_PACKAGE_DLT_DAEMON=y
BR2_PACKAGE_DLT_DAEMON_SYSTEMD_JOURNAL=y
BR2_PACKAGE_DLT_DAEMON_SYSTEM=y
BR2_PACKAGE_DLT_DAEMON_CONSOLE=y
BR2_PACKAGE_SWUPDATE=y
BR2_PACKAGE_SWUPDATE_CONFIG="$(BR2_EXTERNAL_BDXIOT_EXTERNAL_PATH)/board/common/swupdate/defconfig"
BR2_PACKAGE_NANO=y
BR2_PACKAGE_VIM=y
BR2_TARGET_ROOTFS_EXT2=y
BR2_TARGET_ROOTFS_EXT2_4=y
BR2_TARGET_ROOTFS_EXT2_SIZE="384M"
BR2_TARGET_ROOTFS_EXT2_ZSTD=y
BR2_TARGET_ARM_TRUSTED_FIRMWARE=y
BR2_TARGET_ARM_TRUSTED_FIRMWARE_PLATFORM="warp7"
BR2_TARGET_ARM_TRUSTED_FIRMWARE_FIP=y
BR2_TARGET_ARM_TRUSTED_FIRMWARE_BL32_OPTEE=y
BR2_TARGET_ARM_TRUSTED_FIRMWARE_UBOOT_AS_BL33=y
BR2_TARGET_OPTEE_OS=y
BR2_TARGET_OPTEE_OS_PLATFORM="imx-mx7swarp7_mbl"
BR2_TARGET_OPTEE_OS_ADDITIONAL_VARIABLES="CFG_TEE_CORE_LOG_LEVEL=2 CFG_ENABLE_EMBEDDED_TESTS=n"
BR2_TARGET_UBOOT=y
BR2_TARGET_UBOOT_BUILD_SYSTEM_KCONFIG=y
BR2_TARGET_UBOOT_CUSTOM_VERSION=y
BR2_TARGET_UBOOT_CUSTOM_VERSION_VALUE="2025.04"
BR2_TARGET_UBOOT_PATCH="$(BR2_EXTERNAL_BDXIOT_EXTERNAL_PATH)/board/warp7/u-boot/patches"
BR2_TARGET_UBOOT_BOARD_DEFCONFIG="warp7_bl33"
BR2_TARGET_UBOOT_CONFIG_FRAGMENT_FILES="$(BR2_EXTERNAL_BDXIOT_EXTERNAL_PATH)/board/warp7/u-boot/uboot.fragment"
BR2_TARGET_UBOOT_CUSTOM_DTS_PATH="$(BR2_EXTERNAL_BDXIOT_EXTERNAL_PATH)/board/warp7/u-boot/imx7s-warp-extra.dtsi"
BR2_TARGET_UBOOT_NEEDS_OPENSSL=y
BR2_TARGET_UBOOT_NEEDS_GNUTLS=y
BR2_TARGET_UBOOT_FORMAT_IMX=y
BR2_TARGET_UBOOT_INITIAL_ENV=y
BR2_PACKAGE_HOST_DOSFSTOOLS=y
BR2_PACKAGE_HOST_ENVIRONMENT_SETUP=y
BR2_PACKAGE_HOST_GENIMAGE=y
BR2_PACKAGE_HOST_MTOOLS=y
BR2_PACKAGE_HOST_SWUGENERATOR=y
BR2_PACKAGE_HOST_UBOOT_TOOLS=y
BR2_PACKAGE_HOST_UBOOT_TOOLS_FIT_SUPPORT=y
BR2_PACKAGE_HOST_UBOOT_TOOLS_BOOT_SCRIPT=y
BR2_PACKAGE_HOST_UBOOT_TOOLS_BOOT_SCRIPT_SOURCE="$(BR2_EXTERNAL_BDXIOT_EXTERNAL_PATH)/board/warp7/u-boot/boot.cmd"
```

## package/dlt-daemon/Config.in
```kconfig
config BR2_PACKAGE_DLT_DAEMON
	bool "dlt-daemon"
	depends on BR2_TOOLCHAIN_HAS_THREADS
	help
	  COVESA Diagnostic Log and Trace daemon and client library.

	  https://github.com/COVESA/dlt-daemon

if BR2_PACKAGE_DLT_DAEMON

config BR2_PACKAGE_DLT_DAEMON_CONSOLE
	bool "console tools"
	help
	  Build the DLT command-line console tools.

config BR2_PACKAGE_DLT_DAEMON_EXAMPLES
	bool "examples"
	help
	  Build the DLT example applications.

config BR2_PACKAGE_DLT_DAEMON_SYSTEM
	bool "system monitor"
	help
	  Build the dlt-system monitor.

config BR2_PACKAGE_DLT_DAEMON_ADAPTOR
	bool "adaptor"
	help
	  Build both the DLT stdin and UDP adaptors.

config BR2_PACKAGE_DLT_DAEMON_ADAPTOR_STDIN
	bool "stdin adaptor"
	help
	  Build the DLT stdin adaptor.

config BR2_PACKAGE_DLT_DAEMON_ADAPTOR_UDP
	bool "UDP adaptor"
	help
	  Build the DLT UDP adaptor.

config BR2_PACKAGE_DLT_DAEMON_UDP_CONNECTION
	bool "UDP connection"
	help
	  Enable UDP multicast connections in the daemon.

config BR2_PACKAGE_DLT_DAEMON_IPV6
	bool "IPv6 support"
	help
	  Enable IPv6 support in dlt-daemon.

config BR2_PACKAGE_DLT_DAEMON_FILETRANSFER
	bool "file transfer"
	depends on BR2_PACKAGE_DLT_DAEMON_SYSTEM
	select BR2_PACKAGE_ZLIB
	help
	  Enable file transfer support in dlt-system.

config BR2_PACKAGE_DLT_DAEMON_DBUS
	bool "D-Bus adaptor"
	depends on BR2_USE_MMU # dbus
	select BR2_PACKAGE_DBUS
	help
	  Build the DLT D-Bus adaptor.

config BR2_PACKAGE_DLT_DAEMON_LOGSTORAGE_GZIP
	bool "gzip log storage"
	select BR2_PACKAGE_ZLIB
	help
	  Enable gzip compression in DLT log storage.

config BR2_PACKAGE_DLT_DAEMON_EXTENDED_FILTERING
	bool "extended filtering"
	depends on BR2_TOOLCHAIN_HAS_SYNC_4 # json-c
	select BR2_PACKAGE_JSON_C
	help
	  Enable JSON-based extended filtering.

config BR2_PACKAGE_DLT_DAEMON_SYSTEMD_WATCHDOG
	bool "systemd watchdog"
	depends on BR2_PACKAGE_SYSTEMD
	help
	  Enable the systemd watchdog for dlt-daemon.

config BR2_PACKAGE_DLT_DAEMON_SYSTEMD_JOURNAL
	bool "systemd journal"
	depends on BR2_PACKAGE_SYSTEMD && BR2_PACKAGE_DLT_DAEMON_SYSTEM
	help
	  Enable systemd journal integration in dlt-system.

endif

comment "dlt-daemon needs a toolchain w/ threads"
	depends on !BR2_TOOLCHAIN_HAS_THREADS
```

## package/optee-i2c-test/Config.in
```kconfig
config BR2_PACKAGE_OPTEE_I2C_TEST
	bool "optee-i2c-test"
	depends on BR2_TARGET_OPTEE_OS
	select BR2_PACKAGE_OPTEE_CLIENT
	help
	  Test TA and command line client for the OP-TEE I2C device
	  drivers (LM75, MCP23008, MCP7940x, AT24, PCF8591) exposed by
	  the i2c_devices PTA (CFG_I2C_DEVICES_PTA=y).

	  The TA lets any normal world client reach the secure I2C
	  devices: development images only.
```
